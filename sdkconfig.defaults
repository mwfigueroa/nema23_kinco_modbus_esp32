## sdkconfig.defaults
```kconfig
# sdkconfig.defaults — NEMA23 LILYGO T-CAN485
# Target: ESP32 (no P4), WiFi + RS485 + CAN + Stepper

CONFIG_IDF_TARGET="esp32"
CONFIG_IDF_TARGET_ESP32=y

# WiFi
CONFIG_ESP_WIFI_SSID="NEMA23_Gateway"
CONFIG_ESP_WIFI_PASSWORD="12345678"
CONFIG_ESP_WIFI_CHANNEL=1
CONFIG_ESP_MAXIMUM_RETRY=5
CONFIG_ESP_WIFI_STATIC_RX_BUFFER_NUM=10
CONFIG_ESP_WIFI_DYNAMIC_RX_BUFFER_NUM=32

# LWIP (para Modbus TCP)
CONFIG_LWIP_MAX_SOCKETS=16
CONFIG_LWIP_SO_REUSE=y
CONFIG_LWIP_TCPIP_TASK_STACK_SIZE=4096

# FreeRTOS
CONFIG_FREERTOS_HZ=1000
CONFIG_FREERTOS_TIMER_TASK_STACK_DEPTH=4096
CONFIG_FREERTOS_MAX_TASK_NAME_LEN=16

# UART (RS485 y debug)
CONFIG_UART_ISR_IN_IRAM=y

# RMT (para FastAccelStepper)
CONFIG_RMT_ISR_IRAM_SAFE=y

# SPI Flash
CONFIG_ESPTOOLPY_FLASHSIZE_4MB=y
CONFIG_ESPTOOLPY_FLASHSIZE="4MB"

# Partition table
CONFIG_PARTITION_TABLE_CUSTOM=y
CONFIG_PARTITION_TABLE_CUSTOM_FILENAME="partitions.csv"
CONFIG_PARTITION_TABLE_FILENAME="partitions.csv"

# Log level
CONFIG_LOG_DEFAULT_LEVEL_INFO=y
CONFIG_LOG_MAXIMUM_LEVEL_INFO=y

# Main task stack
CONFIG_ESP_MAIN_TASK_STACK_SIZE=8192

# Compiler
CONFIG_COMPILER_OPTIMIZATION_SIZE=y
```
